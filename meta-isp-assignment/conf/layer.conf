## meta-isp-assignment/conf/layer.conf
```bitbake
BBPATH .= ":${LAYERDIR}"

BBFILES += "${LAYERDIR}/recipes-*/*/*.bb \
            ${LAYERDIR}/recipes-*/*/*.bbappend"

BBFILE_COLLECTIONS += "isp-assignment"
BBFILE_PATTERN_isp-assignment = "^${LAYERDIR}/"
BBFILE_PRIORITY_isp-assignment = "6"

LAYERSERIES_COMPAT_isp-assignment = "scarthgap"
```
